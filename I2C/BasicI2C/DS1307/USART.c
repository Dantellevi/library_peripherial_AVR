#include "USART.h"



//-------------------------------------------------------------------------
//	Функция инициализации USART.
//
//	Принимает аргументы:
//
//		long int baudrate - Передает функции значение скорости передачи в БОД.
//-------------------------------------------------------------------------

void Usart_Init(long int baudrate)
{

	UBRRH=((F_CPU/16/baudrate-1)>>8);
	UBRRL = (F_CPU/16/baudrate-1);

	UCSRA = 0x00;
	UCSRB |= (3 << TXEN) | (1 << RXCIE);
	UCSRC = (1 << URSEL) | (3 << UCSZ0);

}


//-------------------------------------------------------------------------
//	Функция передачи байта в USART.
//	Принимает аргументы:
//
//		BYTE data - Передает функции байт, который необходимо послать в порт.
//						  Данная функция не использует прерывания USART.
//-------------------------------------------------------------------------

void Usart_char_out(char data)
{

	while (!( UCSRA & (1 << UDRE)));
	UDR = data;
}


//-------------------------------------------------------------------------
//	Функция чтения байта из USART.
//
//	Возвращаемые данные функцией:
//
//		char - Возвращает принятый байт из USART.
//					 Данная функция не использует прерывания USART.
//-------------------------------------------------------------------------
char Usart_char_in(void)
{
	while (!(UCSRA & (1 << RXC)));
	return UDR;

}



//-------------------------------------------------------------------------
//	Функция передачи строки в USART.
//
//	Принимает аргументы:
//
//		char *str - Передает функции указатель на адрес первого элемента
//						  массива, который необходимо послать в порт.
//						  Строковый массив обязательно должен заканчивотся
//						  нулевым символом \0.
//-------------------------------------------------------------------------
void Usart_str_out(char *str,char count)
{

	char i=0;
	while(i<count)
	{
		Usart_char_out(*str);
		str++;
		i++;

	}

}



void Usart_PrintString(char *str)
{

	char i=0;
	while(*str)
	{
		Usart_char_out(*str);
		str++;
		i++;

	}
	Usart_char_out(0x0D);
	Usart_char_out(0x0A);
}



//-------------------------------------------------------------------------
//	Функция передачи строки в USART для RS-485 MH-BUS.
//
//	Принимает аргументы:
//
//		char *str - Передает функции указатель на адрес первого элемента
//						  массива, который необходимо послать в порт.
//
//-------------------------------------------------------------------------

void Usart_MutBUS_out(char *str)
{
	char i=0;
	while (i<11)
	{
		Usart_char_out(*str);
		str++;
		i++;
	}

}


//-------------------------------------------------------------------------
//	Функция получения строки записанную в буфер из USART
//
//	Передаваемые параметры параметры:
//
//			char *str - Указатель на адрес первой ячейки массива
//							  Длину массива рекомендуется брать равной
//							  длине буфера. В противном случае возможны
//							  переполнение массива. Либо нужно точно знать
//							  что полученная строка умещается в массив.
//-------------------------------------------------------------------------

char Usart_str_in(char *str, char count)
{
	char out = 0;
	char data = 0;
	char timeout = 0;
	
	while(count > data)
	{
		data = GetData();
		
		// Если в течении пол секунды данные не пришли
		// то выйти из функции и вернуть 0
		if(timeout >= 500)
		{
			ClearBuffer();
			return out;
		}
		
		timeout++;
		_delay_ms(1);
	}
	
	out = OutBufferStr(str, count);
	return out;
}


//-------------------------------------------------------------------------
//	Функция передачи строки в USART.
//
//	Принимает аргументы:
//
//		char *str - Передает функции указатель на адрес первого элемента
//						  массива, который необходимо послать в порт.
//						  Строковый массив обязательно должен заканчивотся
//						  нулевым символом \0. После передачи строки в порт
//						  передается два служебных символа \r\n.
//-------------------------------------------------------------------------

void Usart_str_rn(char *str)
{
	unsigned char i=0;
	while(str[i])
	{
		Usart_char_out(str[i]);
		i++;
	}
	Usart_char_out('\r');
	Usart_char_out('\n');
	
}

//-------------------------------------------------------------------------
//	Функция получения количества байт записанные в буфер из USART
//
//	Возвращаемые параметры:
//
//			char - Количество байт в буфере
//-------------------------------------------------------------------------

char usart_data(void)
{
	return GetData();
}

//-------------------------------------------------------------------------

//--------------------------------------------------------------------------
//Функция отправляет в порт значение целочисленной переменной
//Принимаемые значения:

//				int -целочисленное значение,которое преобразуется в строку

//--------------------------------------------------------------------------
void Usart_int_out(int data)
{
	char str[40];
	itoa(data,str,10);
	Usart_str_rn(str);


}