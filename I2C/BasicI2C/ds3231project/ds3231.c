#include "ds3231.h"


//-------------------------------------------------------------------------
//	Функция инициализации часов реального врмени DS3231.
//
//-------------------------------------------------------------------------

void ds3231_init(void)
{
	char temp=0;
	I2C_Init();
	Start_I2C();
	I2C_SendByte(DS3231_ADD_W);
	I2C_SendByte(DS3231_CONTROL);
	Start_I2C();
	I2C_SendByte(DS3231_ADD_R);
	temp=I2C_ReadByte();
	Stop_I2C();

	Start_I2C();
	I2C_SendByte(DS3231_ADD_W);
	I2C_SendByte(DS3231_CONTROL);
	Start_I2C();
	I2C_SendByte(temp& 0x7F);
	Stop_I2C();

	
}


//-------------------------------------------------------------------------
//
//	Функция записи байта в регистр
//
//	Принимает аргументы:
//
//		 reg // Адрес регистра
//		 data // Байт для записи
//-------------------------------------------------------------------------

void ds3231_write_reg(char reg, char data)
{
	Start_I2C();
	I2C_SendByte(DS3231_ADD_W);
	I2C_SendByte(reg);
	I2C_SendByte(data);
	Stop_I2C();

}


//-------------------------------------------------------------------------
//
//	Функция чтения байта из регистра
//
//	Принимает аргументы:
//
//		BYTE reg // Адрес регистра
//
//	Возвращает прочитанный байт
//-------------------------------------------------------------------------

char ds3231_read_reg(char reg)
{
	char temp=0;
	Start_I2C();
	I2C_SendByte(DS3231_ADD_W);
	I2C_SendByte(reg);
	Start_I2C();
	I2C_SendByte(DS3231_ADD_R);
	temp=I2C_ReadLastByte();
	Stop_I2C();

	return temp;

}



//-------------------------------------------------------------------------
//	Функция подготовки значения данных
//
//
//	Принимает в качестве аргумента десятичное значение
//
//	Возвращаемое значение
//
//		Преобразованное для записи в часы
//
//-------------------------------------------------------------------------

char ds3231_byte(char data)
{
	char temp = 0;
	
	while(data > 9)
	{
		data -= 10;
		temp++;
	}
	
	return (data | (temp << 4));
}

//-------------------------------------------------------------------------
//	Функция чтения времени
//
//
//	Принимает аргумент указатель на первый элемент массива.
//
//	После вызовы данной функции в массиве будет лежать прочитанное время.
//	В первом элементе часы, во втором минуты, в третьем секунды.
//
//	Возвращаемые значения:
//
//	Режим счета часов, либо DS3231_GET_24, либо DS3231_GET_AM, либо DS3231_GET_PM
//
//-------------------------------------------------------------------------

void ds3231_read_time(char *str)
{
	char temp[3];
	unsigned char i=0;
	char hour=0;

	Start_I2C();
	I2C_SendByte(DS3231_ADD_W);
	I2C_SendByte(DS3231_SECONDS);
	Start_I2C();
	I2C_SendByte(DS3231_ADD_R);
	temp[2]=I2C_ReadByte();
	temp[1]=I2C_ReadByte();
	temp[0]=I2C_ReadLastByte();
	Stop_I2C();

	if(temp[0] & 0x40) // AM/PM
	{
		*str = ((temp[0] & 0x0F)+(((temp[0] >> 4) & 0x01) * 10));
		str++;
		
		hour = ((temp[0] >> 5) & 0x01);
		
		i = 1;
		while(i < 3)
		{
			*str = ((temp[i] & 0x0F)+((temp[i] >> 4) * 10));
			str++;
			i++;
		}
	}
	else // 24
	{
		i = 0;
		while(i < 3)
		{
			*str = ((temp[i] & 0x0F)+((temp[i] >> 4) * 10));
			str++;
			i++;
		}
		hour = DS3231_GET_24;
	}
	
}





//-------------------------------------------------------------------------
//	Функция записи времени
//
//	Принимает аргументы:
//
//	Тип счета часов (DS3231_24, либо DS3231_AM, либо DS3231_PM) часы, минуты, секунды.
//
//-------------------------------------------------------------------------

void ds3231_write_time(char h1224, char hours, char minutes, char seconds)
{
	Start_I2C();
	I2C_SendByte(DS3231_ADD_W);
	I2C_SendByte(DS3231_SECONDS);
	I2C_SendByte(ds3231_byte(seconds));
	I2C_SendByte(ds3231_byte(minutes));
	if(h1224 == DS3231_24)
	{
		I2C_SendByte(ds3231_byte(hours) & DS3231_24);
	}
	else
	{
		if(h1224 == DS3231_AM)
		{
			if(hours > 12) hours -= 12;
			I2C_SendByte((ds3231_byte(hours) & DS3231_AM) | DS3231_HOURS_12);
		}
		else
		{
			if(hours > 12) hours -= 12;
			I2C_SendByte(ds3231_byte(hours)| DS3231_PM);
		}
	}
	
	Stop_I2C();

}




//-------------------------------------------------------------------------
//	Функция чтения даты
//
//
//	Принимает аргумент указатель на первый элемент массива.
//
//	После вызовы данной функции в массиве будет лежать прочитанное время.
//	В первом элементе день недели, во втором число, в третьем месяц, в четвертом год 00-99.
//
//
//-------------------------------------------------------------------------

void ds3231_read_data(char *str)
{
	char temp[3];
	unsigned char i = 0;
	
	Start_I2C();
	I2C_SendByte(DS3231_ADD_W);
	I2C_SendByte(DS3231_DAY);
	Start_I2C();
	I2C_SendByte(DS3231_ADD_R);
	*str = I2C_ReadByte();
	temp[0] = I2C_ReadByte();
	temp[1] = I2C_ReadByte();
	temp[2] = I2C_ReadByte();
	Stop_I2C();
	
	str++;
	while(i < 4)
	{
		*str = ((temp[i] & 0x0F)+((temp[i] >> 4) * 10));
		str++;
		i++;
	}
}

