#include "ADClib.h"

float Uaref;
//-------------------------------------------------------------------------
//	Функция инициализации ADC.
//
//	Принимает аргументы:
//
//		float uaref - Передает функции значение опорного напряжения в вольтах.
//		char flag - Включить/выключить, выбрать ИОН. FLAG_INNER_AREF, FLAG_EXTERN_AREF
//float aref,char inref
//-------------------------------------------------------------------------
void adc_init(unsigned char flag,float uaref)
{

	if (flag==1)
	{
		Uaref=2.56;

	}
	else if (flag==2)
	{
		ADMUX|=(1<<REFS0);	//внешнее опорное напряжение
		ADCSRA|=(1<<ADPS0)|(1<<ADPS1)|(1<<ADPS2)|(1<<ADEN);	//частота преобразование 128кГц и разерешение использовать перобарзователь
		ADCSRA|=(1<<ADSC);			//вкл. преобразователь
		Uaref=uaref;

	}
	
	
}

//-------------------------------------------------------------------------
//	Функция получения данных из ADC.
//
//	Возвращает значение:
//
//		int - Значение ADC
//-------------------------------------------------------------------------

unsigned int adc_data(unsigned char ch)
{

	ADMUX=ch|(ADMUX&0xF0);
	_delay_us(10);
	ADCSRA|=(1<<ADSC);
	while((ADCSRA&(1<<ADIF))==0);
	
	return ADCW;
}

//-------------------------------------------------------------------------
//	Функция возвращает значение в вольтах относительно опорного напряжения.
//
//	Возвращает значение:
//
//		float - Значение ADC в вольтах
//-------------------------------------------------------------------------

float adc_voltage(unsigned char ch)
{

	float  value;
	
	
	value=(adc_data(ch)*Uaref)/1024.0;
	
	return value;
}
