#include "CicleBuffer.h"
//-------------------------------------------------------------------------
//						Объявление служебных переменных
//-------------------------------------------------------------------------
unsigned char IndexIN, IndexOUT;
char buffer[BUFFER_SIZE];
char uart_flag = 0;
char uart_old = 0;

//-------------------------------------------------------------------------
//					Функция прерывания USART при получении данных
//-------------------------------------------------------------------------

ISR(USART_RXC_vect)
{
	uart_old = UDR;
	uart_flag = 1;
	InBuffer(uart_old);
}

	
	

	//-------------------------------------------------------------------------
	//						Функция очистки буфера
	//-------------------------------------------------------------------------

	void ClearBuffer(void)
	{
		cli();
		IndexIN = 0;
		IndexOUT = 0;
		sei();
	}

	//-------------------------------------------------------------------------
	//			Функция возвращает количество непрочитанных байт в буфере
	//-------------------------------------------------------------------------

	//-------------------------------------------------------------------------
	//
	//	Возвращаемые данные функцией:
	//
	//		char - Возвращает число равное количеству байт в буфере
	//					  прочитанные из порта.
	//
	//-------------------------------------------------------------------------

	char IndexNumber(void)
	{
		if (IndexIN >= IndexOUT)
		{
			return (IndexIN - IndexOUT);
		}
		else
		{
			return ((BUFFER_SIZE - IndexOUT) + IndexIN);
		}
	}

	////-------------------------------------------------------------------------
	////					Функция загрузки байта данных в буфер
	////-------------------------------------------------------------------------
//
	//-------------------------------------------------------------------------
	//
	//	Принимает аргументы:
	//
	//		char value - Передает функции байт, который необходимо
	//							загрузить в буфер. Увеличение счетчика
	//							адреса происходит автоматически.
	//
	//	Возвращаемые значения:
	//
	//		char - Функция возвращает коды выполнения операции.
	//					  Коды: BUFFER_OK - Операция выполнена успешно
	//							BUFFER_OVERFLOW - Переполнение буфера
	//
	//-------------------------------------------------------------------------

	void InBuffer(char val)
	{
		IndexIN++;
		IndexIN &= BUFFER_MASK;
		buffer[IndexIN] = val;
	}

	//-------------------------------------------------------------------------
	//					Функция выгрузки строки данных из буфера
	//-------------------------------------------------------------------------

	//-------------------------------------------------------------------------
	//
	//	Принимает аргументы:
	//
	//		char *str - Передает функции указатель на адрес первого элемента
	//						   массива в который необходимо записать строку из буфера.
	//
	//		char lenght - Передает фугкции длинну принимаемой строки в байтах.
	//
	//	После вызова данной функции в массиве будет находится строка прочитанная из
	//	буфера.
	//
	//-------------------------------------------------------------------------

	char OutBufferStr(char *str, char lenght)
	{
		for(char i=0; i<lenght; i++)
		{
			IndexOUT++;
			IndexOUT &= BUFFER_MASK;
			*str = buffer[IndexOUT];
			str++;
		}
		uart_flag = 0;
		
		return lenght;
	}

	//-------------------------------------------------------------------------
	//				Функция возвращает количество байт не прочитанных данных
	//				Если нанных нет, то возвращается 0
	//-------------------------------------------------------------------------

	//-------------------------------------------------------------------------
	//
	//	Возвращаемые значения:
	//
	//		char - Функция возвращает коды выполнения операции.
	//					  Коды: 0				- Буфер пустой
	//							Количество байт - В буфере присутствуют не прочитанные данные
	//
	//-------------------------------------------------------------------------

	char GetData(void)
	{
		if(IndexIN != IndexOUT)
		{
			return IndexNumber();
		}
		return 0;
	}

	//-------------------------------------------------------------------------

