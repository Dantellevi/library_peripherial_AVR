#include "MAX7219.h"

/*
===================Функция передачи на MAX7219===========
		Принимаемые параметры:
			register-нужный регистр
			data-данные для передачи в указанный регистр
*/
void Send_MAX7219(char reg,char data)
{
	PORTB&=~(1<<PB4);
	SPI_SendByte(reg);
	
	SPI_SendByte(data);
	PORTB|=(1<<PB4);



}

/*
===============Функция очистки модуля=============
			Принимаемые параметры:
				dg-количество используемых разрядов


*/
void Clear_7219(char dg)

{

	char i = dg;

	do {

		Send_MAX7219(i,0xF); //символ пустоты

	} while (--i);

}



/*
=======================Функция передачи большого числа==========
		Принимаемые значения:
			n-величина для вывода на индикатор

*/

void Number_MAX7219(volatile long n)
{
	char ng = 0; //переменная для минуса
	if (n < 0)
	{
		ng = 1;
		n *= -1;
	}
	Clear_7219(8);
	if (n == 0) 
	{
		Send_MAX7219(0x01, 0); //в первый разряд напишем 0
		return;
	}
	char i=0;			//переменная для счетчика
	do{
		Send_MAX7219(++i,n%10);	//передаем команду на вывод в i сегмент значения равное n%10
		n/=10;
	}while(n);
	if (ng)
	{
		Send_MAX7219(i+1,0xA);
	}
}